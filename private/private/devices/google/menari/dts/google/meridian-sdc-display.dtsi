// SPDX-License-Identifier: GPL-2.0

#include <dt-bindings/clock/qcom,dispcc-monaco.h>
#include "dsi-panel-amb133ha01-amoled-cmd.dtsi"

&dsi_amb133ha01_amoled_13_cmd {
	qcom,ulps-enabled;
	qcom,mdss-dsi-t-clk-post = <0x0B>;
	qcom,mdss-dsi-t-clk-pre = <0x15>;
	qcom,dsi-select-clocks = "pll_byte_clk0", "pll_dsi_clk0";

	qcom,esd-check-enabled;
	qcom,mdss-dsi-panel-status-check-mode = "reg_read";
	qcom,mdss-dsi-panel-status-command = [06 01 00 01 00 00 01 0f];
	qcom,mdss-dsi-panel-status-command-state = "dsi_hs_mode";
	qcom,mdss-dsi-panel-status-value = <0xc0>;
	qcom,mdss-dsi-panel-status-read-length = <1>;

	qcom,mdss-dsi-display-timings {
		timing@0 {
			qcom,mdss-dsi-panel-phy-timings =  [00 18 06 06 15 20 06
				06 07 02 04 00 15 0B];
			qcom,display-topology = <1 0 1>;
			qcom,default-topology-index = <0>;
			qcom,mdss-dsi-h-pulse-width = <220>;
			qcom,mdss-dsi-v-pulse-width = <221>;
			qcom,mdss-dsi-panel-clockrate = <676065600>;
		};
	};
};
