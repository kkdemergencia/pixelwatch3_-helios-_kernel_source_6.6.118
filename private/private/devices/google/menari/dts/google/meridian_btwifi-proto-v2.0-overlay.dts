// SPDX-License-Identifier: GPL-2.0

/dts-v1/;
/plugin/;

#include "meridian-proto-v2.0.dtsi"

/ {
	model = "Google Meridian BTWIFI Proto 2.0";
	qcom,board-id = <0x010022 0x1>;
	board_id = <0x020e02>;
	board_rev = <0x020000>;
};
