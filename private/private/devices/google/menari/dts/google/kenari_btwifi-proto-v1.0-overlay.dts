// SPDX-License-Identifier: GPL-2.0

/dts-v1/;
/plugin/;

#include "kenari-proto-v1.0.dtsi"

/ {
	model = "Google Kenari BTWIFI Proto 1.0";
	qcom,board-id = <0x010022 0x1>;
	board_id = <0x021002>;
	board_rev = <0x010000>;
};
