// SPDX-License-Identifier: GPL-2.0

#include "../google-dts-base/sw5100-rt595.dtsi"
#include "menari-common.dtsi"
#include "meridian-battery.dtsi"
#include "menari-nfc.dtsi"
#include "menari-uwb.dtsi"
#include "menari-crown-proto.dtsi"
#include "menari-bt.dtsi"
#include "meridian-wifi.dtsi"
#include "menari-sdhc.dtsi"
#include "menari-haptics.dtsi"
#include "menari-audio.dtsi"
#include "menari-wdc.dtsi"
#include "menari-mcu-power.dtsi"

&mcu {
	board_type = "meridian_evt1";
	main_image = "mcu_meridian_evt1_main.elf";
};

&sensorhub {
	sensorhub,firmware = "mcu_meridian_evt1.bin";
};
