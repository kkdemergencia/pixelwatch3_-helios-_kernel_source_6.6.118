// SPDX-License-Identifier: GPL-2.0

/dts-v1/;
/plugin/;

#include "luna-proto-v1.1.dtsi"

/ {
	model = "Google Luna Proto 1.1";
	qcom,board-id = <0x010022 0x1>;
	board_id = <0x020a02>;
	board_rev = <0x010100>;
};
