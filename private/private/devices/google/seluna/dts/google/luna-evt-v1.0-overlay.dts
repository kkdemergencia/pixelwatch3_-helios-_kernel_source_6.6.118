// SPDX-License-Identifier: GPL-2.0

/dts-v1/;
/plugin/;

#include "luna-evt-v1.0.dtsi"

/ {
	model = "Google Luna EVT 1.0";
	qcom,board-id = <0x010022 0x1>;
	board_id = <0x020a03>;
	board_rev = <0x010000>;
};
