// SPDX-License-Identifier: GPL-2.0

/dts-v1/;
/plugin/;

#include "selene-nff-v2.1.dtsi"

/ {
	model = "Google Helios NFF 2.1";
	qcom,board-id = <0x010022 0x1>;
	board_id = <0x020901>;
	board_rev = <0x020100>;
};
