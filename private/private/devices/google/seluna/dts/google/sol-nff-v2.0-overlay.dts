// SPDX-License-Identifier: GPL-2.0

/dts-v1/;
/plugin/;

#include "luna-nff-v2.0.dtsi"

/ {
	model = "Google Sol NFF 2.0";
	qcom,board-id = <0x010022 0x1>;
	board_id = <0x020b01>;
	board_rev = <0x020000>;
};
