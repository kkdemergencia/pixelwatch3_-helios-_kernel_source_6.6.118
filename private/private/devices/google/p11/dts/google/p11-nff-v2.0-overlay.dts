// SPDX-License-Identifier: GPL-2.0

/dts-v1/;
/plugin/;

#include "p11-nff-v2.0.dtsi"

/ {
	model = "Google P11 NFF 2.0";
	qcom,board-id = <0x010022 0x1>;
	board_id = <0x020601>;
	board_rev = <0x020000>;
};
