/*
 * Copyright (c) 2024 Qualcomm Innovation Center, Inc. All rights reserved.
 * SPDX-License-Identifier: BSD-3-Clause
 */

/dts-v1/;
/plugin/;

#include "monaco-slate-dmic-audio.dtsi"

/ {
	model = "Qualcomm Technologies, Inc. Monaco IDP V1.0";
	compatible = "qcom,monaco", "qcom,idp";
	qcom,board-id = <0x010022 0x0>, <0x010122 0x0>;
};
