// SPDX-License-Identifier: GPL-2.0

&mdss_mdp {
	/*
	 * The panel name (ex: qcom,mdss_dsi_wj014sgm_amoled_14_cmd) must match
	 * the 3rd argument to PANEL_CREATE_ENTRY() in xbl (boot_images)
	 * QcomPkg/SocPkg/AthertonPkg/Library/MDPPlatformLib/MDPPlatformLib.c
	 */

	dsi_wj014sgm_amoled_14_cmd: qcom,mdss_dsi_wj014sgm_amoled_14_cmd {
		qcom,mdss-dsi-panel-name = "FL22-BOE-WJ014SGM";
		qcom,mdss-dsi-panel-type = "dsi_cmd_mode";
		qcom,mdss-dsi-panel-physical-type = "oled";
		qcom,mdss-dsi-virtual-channel-id = <0>;
		qcom,mdss-dsi-stream = <0>;
		qcom,mdss-dsi-bpp = <24>;
		qcom,mdss-dsi-color-order = "rgb_swap_rgb";
		qcom,mdss-dsi-underflow-color = <0xff>;
		qcom,mdss-dsi-border-color = <0>;
		qcom,mdss-pan-physical-width-dimension = <36>;
		qcom,mdss-pan-physical-height-dimension = <36>;

		qcom,dsi-ctrl-num = <0>;
		qcom,dsi-phy-num = <0>;

		qcom,mdss-dsi-traffic-mode = "burst_mode";
		qcom,mdss-dsi-lane-map = "lane_map_0123";
		qcom,mdss-dsi-bllp-eof-power-mode;
		qcom,mdss-dsi-bllp-power-mode;
		qcom,mdss-dsi-lane-0-state;
		qcom,mdss-dsi-dma-trigger = "trigger_sw";
		qcom,mdss-dsi-mdp-trigger = "none";
		qcom,mdss-dsi-reset-sequence = <1 10>, <0 10>, <1 10>;
		qcom,mdss-dsi-esd-post-reset-time = <100>;
		qcom,mdss-dsi-te-pin-select = <1>;
		qcom,mdss-dsi-te-dcs-command = <1>;
		qcom,mdss-dsi-te-check-enable;
		qcom,mdss-dsi-te-using-te-pin;

		qcom,mdss-dsi-t-clk-post = <0x09>;
		qcom,mdss-dsi-t-clk-pre = <0x0E>;

		qcom,platform-te-gpio = <&tlmm 73 0>;
		qcom,panel-te-source = <0>;
		qcom,panel-dimming-off-from-off-to-on-enable;
		qcom,panel-reset-delay-on-to-on = <100>;

		qcom,mdss-dsi-bl-pmic-control-type = "bl_ctrl_dcs";
		qcom,mdss-dsi-bl-min-level = <1>;
		qcom,mdss-dsi-bl-max-level = <511>; /* NBM 0-255, HBM 256-511 */
		qcom,mdss-brightness-max-level = <511>;
		qcom,mdss-brightness-default-level = <182>;
		qcom,mdss-dsi-bl-aod-min-level = <1>;
		qcom,mdss-dsi-bl-aod-max-level = <255>;
		qcom,mdss-dsi-bl-hbm-min-level = <0>;
		qcom,mdss-dsi-bl-hbm-max-level = <255>;

		qcom,dsi-bl-aod-dbv-reg = <0x61>;
		qcom,dsi-bl-inter-dbv-reg = <0x51>;
		qcom,dsi-bl-hbm-dbv-reg = <0x63>;

		qcom,mdss-dsi-mode-transition-time = <120>;

		qcom,mdss-dsi-display-timings {
			timing@0 {
				qcom,mdss-dsi-panel-framerate = <60>;
				qcom,mdss-dsi-panel-width = <456>;
				qcom,mdss-dsi-panel-height = <456>;
				qcom,mdss-dsi-h-front-porch = <40>;
				qcom,mdss-dsi-h-back-porch = <20>;
				qcom,mdss-dsi-h-pulse-width = <20>;
				qcom,mdss-dsi-h-sync-skew = <0>;
				qcom,mdss-dsi-v-front-porch = <20>;
				qcom,mdss-dsi-v-back-porch = <20>;
				qcom,mdss-dsi-v-pulse-width = <20>;
				qcom,mdss-dsi-h-left-border = <0>;
				qcom,mdss-dsi-h-right-border = <0>;
				qcom,mdss-dsi-v-top-border = <0>;
				qcom,mdss-dsi-v-bottom-border = <0>;
				qcom,mdss-dsi-panel-phy-timings = [00 10 03 03 11 1E 04
					04 03 02 04 00 0E 09];

				qcom,mdss-dsi-on-command-state = "dsi_lp_mode";
				qcom,mdss-dsi-on-command = [
					15 00 00 00 00 00 02 ff d0 /* Page Select */
					15 00 00 00 00 00 02 f9 01 /* prevent loading default */
					15 00 00 00 00 00 02 22 10 /* To prevent ULPS excessive current */
					15 00 00 00 00 00 02 ff 10 /* Page select */
					15 00 00 00 00 00 02 f9 01 /* prevent loading default */
					15 00 00 00 00 00 02 55 01 /* ACL on */
					15 00 00 00 00 00 02 ff 10 /* Page select */
					15 00 00 00 00 00 02 63 FF /* HBM max DBV */
					15 00 00 00 00 00 02 71 82 /* TE follow base frame rate 60 Hz */
					15 00 00 00 00 00 02 76 77 /* Enable skip mode */
					15 00 00 00 00 00 02 6e 72 /* NBM default 1Hz */
					15 00 00 00 00 00 02 6f 72 /* AOD default 1Hz */
					15 00 00 00 00 00 02 ff 20 /* Fix HW reddish issue */
					15 00 00 00 00 00 02 f9 01
					15 00 00 00 00 00 02 7a 61
					15 00 00 00 00 00 02 ff 24
					15 00 00 00 00 00 02 f9 01
					15 00 00 00 00 00 02 00 29
					15 00 00 00 00 00 02 06 29
					15 00 00 00 00 00 02 0a 29
					15 00 00 00 00 00 02 13 29
					15 00 00 00 00 00 02 6a 95
					15 00 00 00 00 00 02 78 95
					15 00 00 00 00 00 02 80 15
					15 00 00 00 00 00 02 9e 95
					15 00 00 00 00 00 02 ae 95
					15 00 00 00 00 00 02 b6 4b
					15 00 00 00 00 00 02 c5 4b
					15 00 00 00 00 00 02 d4 4b
					15 00 00 00 00 00 02 e3 4b
					15 00 00 00 00 00 02 ff 25
					15 00 00 00 00 00 02 f9 01
					15 00 00 00 00 00 02 02 4b
					15 00 00 00 00 00 02 38 0e
					15 00 00 00 00 00 02 53 1b
					15 00 00 00 00 00 02 54 00
					15 00 00 00 00 00 02 ba 24
					15 00 00 00 00 00 02 ff 20 /* Fix HW blip issue */
					15 00 00 00 00 00 02 f9 01
					15 00 00 00 00 00 02 81 01
					15 00 00 00 00 00 02 84 00
					15 00 00 00 00 00 02 85 70
					15 00 00 00 00 00 02 7d 11
					15 00 00 00 00 00 02 58 27
					15 00 00 00 00 00 02 e5 20
					15 00 00 00 00 00 02 59 18
					39 00 00 00 00 00 06 5d 16 16 49 00 00
					39 00 00 00 00 00 06 61 02 16 49 51 00
					15 00 00 00 00 00 02 ff 23
					15 00 00 00 00 00 02 f9 01
					15 00 00 00 00 00 02 92 01
					15 00 00 00 00 00 02 ff 26
					15 00 00 00 00 00 02 f9 01
					15 00 00 00 00 00 02 8d 03
					15 00 00 00 00 00 02 ff 27
					15 00 00 00 00 00 02 f9 01
					15 00 00 00 00 00 02 96 11
					15 00 00 00 00 00 02 95 12
					15 00 00 00 00 00 02 ff 10 /* Page select */
					05 00 00 00 64 00 01 11    /* Sleep out, wait 100ms */
					05 00 00 00 00 00 01 29    /* Disp on */
				];
				qcom,mdss-dsi-off-command-state = "dsi_hs_mode";
				qcom,mdss-dsi-off-command = [
					15 00 00 00 00 00 02 ff 10 /* Page select */
					05 00 00 00 00 00 01 28    /* Disp off */
					05 00 00 00 43 00 01 10    /* Sleep in, wait 67ms */
				];
				qcom,mdss-dsi-lp1-command-state = "dsi_hs_mode";
				qcom,mdss-dsi-lp1-command = [
					15 00 00 00 00 00 02 ff 20 /* AoD blip code */
					15 00 00 00 00 00 02 f9 01
					15 00 00 00 00 00 02 81 01
					15 00 00 00 00 00 02 84 00
					15 00 00 00 00 00 02 85 70
					15 00 00 00 00 00 02 7d 11
					15 00 00 00 00 00 02 58 27
					15 00 00 00 00 00 02 e5 20
					15 00 00 00 00 00 02 59 18
					39 00 00 00 00 00 06 5d 16 16 49 00 00
					39 00 00 00 00 00 06 61 02 16 49 51 00
					15 00 00 00 00 00 02 ff 23
					15 00 00 00 00 00 02 f9 01
					15 00 00 00 00 00 02 92 01
					15 00 00 00 00 00 02 ff 26
					15 00 00 00 00 00 02 f9 01
					15 00 00 00 00 00 02 8d 03
					15 00 00 00 00 00 02 ff 27
					15 00 00 00 00 00 02 f9 01
					15 00 00 00 00 00 02 96 11
					15 00 00 00 11 00 02 95 12
					15 00 00 00 00 00 02 ff 10 /* Page select */
					05 00 00 00 00 00 01 39    /* Enter idle */
				];
				qcom,mdss-dsi-lp2-command-state = "dsi_hs_mode";
				qcom,mdss-dsi-lp2-command = [
					15 00 00 00 00 00 02 ff 10 /* Page select */
					05 00 00 00 00 00 01 39    /* Enter idle */
				];
				qcom,mdss-dsi-nolp-command = [
					15 00 00 00 00 00 02 ff 10 /* Page select */
					05 00 00 00 78 00 01 38    /* Exit idle, idle 120ms */
				];
				qcom,mdss-dsi-hbm-on-command = [
					15 00 00 00 00 00 02 ff 20 /* HBM blip code */
					15 00 00 00 00 00 02 f9 01
					15 00 00 00 00 00 02 81 7a
					15 00 00 00 00 00 02 84 20
					15 00 00 00 00 00 02 85 70
					15 00 00 00 00 00 02 7d 21
					15 00 00 00 00 00 02 58 20
					15 00 00 00 00 00 02 e5 00
					15 00 00 00 00 00 02 59 21
					39 00 00 00 00 00 06 5d 49 16 00 00 00
					39 00 00 00 00 00 06 61 02 16 49 51 00
					15 00 00 00 00 00 02 ff 23
					15 00 00 00 00 00 02 f9 01
					15 00 00 00 00 00 02 92 09
					15 00 00 00 00 00 02 ff 26
					15 00 00 00 00 00 02 f9 01
					15 00 00 00 00 00 02 8d 01
					15 00 00 00 00 00 02 ff 27
					15 00 00 00 00 00 02 f9 01
					15 00 00 00 00 00 02 96 12
					15 00 00 00 11 00 02 95 11
					15 00 00 00 00 00 02 ff 10 /* Page select */
					15 00 00 00 00 00 02 76 76 /* Disable skip mode */
					15 00 00 00 00 00 02 66 02 /* Enter HBM */
				];
				qcom,mdss-dsi-hbm-off-command = [
					15 00 00 00 00 00 02 ff 10 /* Page select */
					15 00 00 00 00 00 02 76 77 /* Enable skip mode */
					15 00 00 00 00 00 02 66 00 /* Leave HBM */
				];
				qcom,mdss-dsi-dimming-on-command = [
					15 00 00 00 00 00 02 ff 10 /* Page select */
					15 00 00 00 00 00 02 53 28 /* Enable dimming */
				];
				qcom,mdss-dsi-dimming-off-command = [
					15 00 00 00 00 00 02 ff 10 /* Page select */
					15 00 00 00 00 00 02 53 20 /* Disable dimming */
				];
			};
		};
	};
};
