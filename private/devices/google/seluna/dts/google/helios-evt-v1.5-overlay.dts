// SPDX-License-Identifier: GPL-2.0

/dts-v1/;
/plugin/;

#include "selene-evt-v1.5.dtsi"

/ {
	model = "Google Helios EVT 1.5";
	qcom,board-id = <0x010022 0x1>;
	board_id = <0x020903>;
	board_rev = <0x010500>;
};
