// SPDX-License-Identifier: GPL-2.0

/dts-v1/;
/plugin/;

#include "luna-proto-v1.0.dtsi"

/ {
	model = "Google Sol Proto 1.0";
	qcom,board-id = <0x010022 0x1>;
	board_id = <0x020b02>;
	board_rev = <0x010000>;
};
