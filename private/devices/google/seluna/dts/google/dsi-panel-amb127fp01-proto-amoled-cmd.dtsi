// SPDX-License-Identifier: GPL-2.0

&mdss_mdp {
	/*
	 * The panel name (ex: qcom,mdss_dsi_amb127fp01_proto_amoled_12_cmd) must match
	 * the 3rd argument to PANEL_CREATE_ENTRY() in xbl (boot_images)
	 * QcomPkg/SocPkg/AthertonPkg/Library/MDPPlatformLib/MDPPlatformLib.c
	 */

	dsi_amb127fp01_proto_amoled_12_cmd: qcom,mdss_dsi_amb127fp01_proto_amoled_12_cmd {
		qcom,mdss-dsi-panel-name = "FSE22-SDC-AMB127FP01";
		qcom,mdss-dsi-panel-type = "dsi_cmd_mode";
		qcom,mdss-dsi-panel-physical-type = "oled";
		qcom,mdss-dsi-virtual-channel-id = <0>;
		qcom,mdss-dsi-stream = <0>;
		qcom,mdss-dsi-bpp = <24>;
		qcom,mdss-dsi-color-order = "rgb_swap_rgb";
		qcom,mdss-dsi-underflow-color = <0xff>;
		qcom,mdss-dsi-border-color = <0>;
		qcom,mdss-pan-physical-width-dimension = <32>;
		qcom,mdss-pan-physical-height-dimension = <32>;

		qcom,dsi-ctrl-num = <0>;
		qcom,dsi-phy-num = <0>;

		qcom,mdss-dsi-traffic-mode = "burst_mode";
		qcom,mdss-dsi-lane-map = "lane_map_0123";
		qcom,mdss-dsi-bllp-eof-power-mode;
		qcom,mdss-dsi-bllp-power-mode;
		qcom,mdss-dsi-lane-0-state;
		qcom,mdss-dsi-dma-trigger = "trigger_sw";
		qcom,mdss-dsi-mdp-trigger = "none";
		qcom,mdss-dsi-reset-sequence = <1 10>, <0 3>, <1 10>;
		qcom,mdss-dsi-esd-post-reset-time = <100>;
		qcom,mdss-dsi-te-pin-select = <1>;
		qcom,mdss-dsi-te-dcs-command = <1>;
		qcom,mdss-dsi-te-check-enable;
		qcom,mdss-dsi-te-using-te-pin;

		qcom,mdss-dsi-t-clk-post = <0x08>;
		qcom,mdss-dsi-t-clk-pre = <0x0D>;

		qcom,platform-te-gpio = <&tlmm 73 0>;
		qcom,panel-te-source = <0>;
		qcom,panel-dimming-off-from-off-to-on-enable;
		qcom,panel-reset-delay-on-to-on = <100>;

		qcom,mdss-dsi-bl-pmic-control-type = "bl_ctrl_dcs";
		qcom,mdss-dsi-bl-min-level = <1>;
		qcom,mdss-dsi-bl-max-level = <511>; /* NBM 0-255, HBM 256-511 */
		qcom,mdss-brightness-max-level = <511>;
		qcom,mdss-brightness-default-level = <182>;
		qcom,mdss-dsi-bl-aod-min-level = <1>;
		qcom,mdss-dsi-bl-aod-max-level = <255>;
		qcom,mdss-dsi-bl-hbm-min-level = <0>;
		qcom,mdss-dsi-bl-hbm-max-level = <255>;

		qcom,dsi-bl-aod-dbv-reg = <0x61>;
		qcom,dsi-bl-inter-dbv-reg = <0x51>;
		qcom,dsi-bl-hbm-dbv-reg = <0x63>;

		qcom,mdss-dsi-mode-transition-time = <120>;

		qcom,mdss-dsi-display-timings {
			timing@0 {
				qcom,mdss-dsi-panel-framerate = <60>;
				qcom,mdss-dsi-panel-width = <408>;
				qcom,mdss-dsi-panel-height = <408>;
				qcom,mdss-dsi-h-front-porch = <40>;
				qcom,mdss-dsi-h-back-porch = <20>;
				qcom,mdss-dsi-h-pulse-width = <20>;
				qcom,mdss-dsi-h-sync-skew = <0>;
				qcom,mdss-dsi-v-front-porch = <20>;
				qcom,mdss-dsi-v-back-porch = <20>;
				qcom,mdss-dsi-v-pulse-width = <20>;
				qcom,mdss-dsi-h-left-border = <0>;
				qcom,mdss-dsi-h-right-border = <0>;
				qcom,mdss-dsi-v-top-border = <0>;
				qcom,mdss-dsi-v-bottom-border = <0>;
				qcom,mdss-dsi-panel-phy-timings = [00 0E 03 03 11 1D 04
					03 03 02 04 00 0D 08];

				qcom,mdss-dsi-on-command-state = "dsi_lp_mode";
				qcom,mdss-dsi-on-command = [
					15 00 00 00 00 00 02 ff d0 /* Page Select */
					15 00 00 00 00 00 02 f9 01 /* prevent loading default */
					15 00 00 00 00 00 02 22 10 /* To prevent ULPS excessive current */
					15 00 00 00 00 00 02 ff 10 /* Page select */
					15 00 00 00 00 00 02 f9 01 /* prevent loading default */
					15 00 00 00 00 00 02 55 01 /* ACL on */
					15 00 00 00 00 00 02 ff 10 /* Page select */
					15 00 00 00 00 00 02 63 ff /* HBM max DBV */
					15 00 00 00 00 00 02 71 82 /* TE follow base frame rate 60 Hz */
					15 00 00 00 00 00 02 76 77 /* Enable skip mode */
					15 00 00 00 00 00 02 6e 72 /* NBM default 1Hz */
					15 00 00 00 00 00 02 6f 72 /* AOD default 1Hz */
					15 00 00 00 00 00 02 ff 20 /* Fix HW blip issue */
					15 00 00 00 00 00 02 f9 01
					15 00 00 00 00 00 02 58 26
					15 00 00 00 00 00 02 59 0e
					39 00 00 00 00 00 06 5d 15 15 00 00 00
					39 00 00 00 00 00 06 5e 02 0d 49 00 00
					39 00 00 00 00 00 06 60 49 13 02 00 00
					39 00 00 00 00 00 06 61 49 15 02 51 00
					15 00 00 00 00 00 02 7d 11
					15 00 00 00 00 00 02 81 01
					15 00 00 00 00 00 02 84 00
					15 00 00 00 00 00 02 85 68
					15 00 00 00 00 00 02 e5 10
					15 00 00 00 00 00 02 ff 23
					15 00 00 00 00 00 02 f9 01
					15 00 00 00 00 00 02 92 01
					15 00 00 00 00 00 02 ff 26
					15 00 00 00 00 00 02 f9 01
					15 00 00 00 00 00 02 8d 03
					15 00 00 00 00 00 02 ff 27
					15 00 00 00 00 00 02 f9 01
					15 00 00 00 00 00 02 95 12
					15 00 00 00 00 00 02 96 11
					15 00 00 00 00 00 02 ff 10
					15 00 00 00 00 00 02 f9 01
					15 00 00 00 00 00 02 e5 91
					15 00 00 00 00 00 02 ff 26 /* Page Select */
					15 00 00 00 00 00 02 f9 01 /* prevent loading default */
					15 00 00 00 00 00 02 01 01 /* Disabling HBM dynamic ELVSS */
					15 00 00 00 00 00 02 ff 10 /* Page select */
					05 00 00 00 64 00 01 11    /* Sleep out, wait 100ms */
					05 00 00 00 00 00 01 29    /* Disp on */
				];
				qcom,mdss-dsi-off-command-state = "dsi_hs_mode";
				qcom,mdss-dsi-off-command = [
					15 00 00 00 00 00 02 ff 10 /* Page select */
					05 00 00 00 00 00 01 28    /* Disp off */
					05 00 00 00 43 00 01 10    /* Sleep in, wait 67ms */
				];
				qcom,mdss-dsi-lp1-command-state = "dsi_hs_mode";
				qcom,mdss-dsi-lp1-command = [
					15 00 00 00 00 00 02 ff 10 /* Page select */
					05 00 00 00 00 00 01 39    /* Enter idle */
				];
				qcom,mdss-dsi-lp2-command-state = "dsi_hs_mode";
				qcom,mdss-dsi-lp2-command = [
					15 00 00 00 00 00 02 ff 10 /* Page select */
					05 00 00 00 00 00 01 39    /* Enter idle */
				];
				qcom,mdss-dsi-nolp-command = [
					15 00 00 00 00 00 02 ff 10 /* Page select */
					05 00 00 00 78 00 01 38    /* Exit idle, idle 120ms */
				];
				qcom,mdss-dsi-hbm-on-command = [
					15 00 00 00 00 00 02 ff 10 /* Page select */
					15 00 00 00 00 00 02 76 76 /* Disable skip mode */
					15 00 00 00 00 00 02 66 02 /* Enter HBM */
				];
				qcom,mdss-dsi-hbm-off-command = [
					15 00 00 00 00 00 02 ff 10 /* Page select */
					15 00 00 00 00 00 02 76 77 /* Enable skip mode */
					15 00 00 00 00 00 02 66 00 /* Leave HBM */
				];
				qcom,mdss-dsi-dimming-on-command = [
					15 00 00 00 00 00 02 ff 10 /* Page select */
					15 00 00 00 00 00 02 53 28 /* Enable dimming */
				];
				qcom,mdss-dsi-dimming-off-command = [
					15 00 00 00 00 00 02 ff 10 /* Page select */
					15 00 00 00 00 00 02 53 20 /* Disable dimming */
				];
			};
		};
	};
};
