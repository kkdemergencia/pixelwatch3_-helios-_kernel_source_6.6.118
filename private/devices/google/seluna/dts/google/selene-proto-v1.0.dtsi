// SPDX-License-Identifier: GPL-2.0

#include "../google-dts-base/sw5100-rt595.dtsi"
#include "seluna-common-proto-v1.0.dtsi"
#include "selene-battery.dtsi"
#include "../google-dts-base/sw5100-mcu.dtsi"
#include "seluna-wifi-proto-v1.0.dtsi"

&mcu {
	board_type = "selene_p1";
};

&sensorhub {
	sensorhub,firmware = "mcu_selene_p1.bin";
};
