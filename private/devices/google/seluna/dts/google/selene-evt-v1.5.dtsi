// SPDX-License-Identifier: GPL-2.0

#include "../google-dts-base/sw5100-rt595.dtsi"
#include "seluna-common-proto-v1.1.dtsi"
#include "selene-battery.dtsi"
#include "../google-dts-base/sw5100-mcu.dtsi"
#include "seluna-wifi.dtsi"

&mcu {
	board_type = "selene_evt1_5";
};

&sensorhub {
	sensorhub,firmware = "mcu_selene_evt1_5.bin";
};
