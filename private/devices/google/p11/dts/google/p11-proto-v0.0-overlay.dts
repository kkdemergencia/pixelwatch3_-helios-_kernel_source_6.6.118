// SPDX-License-Identifier: GPL-2.0

/dts-v1/;
/plugin/;

#include "p11-proto-v0.0.dtsi"

/ {
	model = "Google P11 Proto 0.0";
	qcom,board-id = <0x010022 0x1>;
	board_id = <0x020602>;
	board_rev = <0x000000>;
};
