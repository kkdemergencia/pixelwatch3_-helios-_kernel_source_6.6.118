// SPDX-License-Identifier: GPL-2.0

/dts-v1/;
/plugin/;

#include "p11-dvt-v1.0.dtsi"

/ {
	model = "Google P11 DVT 1.0";
	qcom,board-id = <0x010022 0x1>;
	board_id = <0x020604>;
	board_rev = <0x010000>;
};
