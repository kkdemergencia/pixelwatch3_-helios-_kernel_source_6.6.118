// SPDX-License-Identifier: GPL-2.0

#include <dt-bindings/clock/qcom,dispcc-monaco.h>
#include "dsi-panel-rm690c0-amoled-17-cmd.dtsi"

&dsi_rm690c0_amoled_17_cmd {
	qcom,ulps-enabled;
	qcom,suspend-ulps-enabled;
	qcom,mdss-dsi-t-clk-post = <0x08>;
	qcom,mdss-dsi-t-clk-pre = <0x0C>;
	qcom,dsi-select-clocks = "pll_byte_clk0", "pll_dsi_clk0";

	qcom,mdss-dsi-panel-status-check-mode = "te_signal_check";
	qcom,mdss-dsi-panel-status-command = [06 00 00 01 00 00 01 0a];
	qcom,mdss-dsi-panel-status-command-state = "dsi_lp_mode";
	qcom,mdss-dsi-panel-status-value = <0xb4>;
	qcom,mdss-dsi-panel-status-read-length = <1>;
	/*
	 * TODO: b/267644923: ESD te_signal_check is not supported anymore,
	 * so ESD checking is temporarily disabled.
	 */
	//qcom,esd-check-enabled;

	qcom,mdss-dsi-display-timings {
		timing@0 {
			qcom,mdss-dsi-panel-phy-timings = [00 0D 03 03 10 1D 04
				03 02 02 04 00 0C 08];
			qcom,display-topology = <1 0 1>;
			qcom,default-topology-index = <0>;
			qcom,mdss-dsi-panel-clockrate = <320664960>;
		};
	};
};

&mdss_dsi_phy0 {
	qcom,dsi-phy-vreg-ctrl = <0x51>;
};
