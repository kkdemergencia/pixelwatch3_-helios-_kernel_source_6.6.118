// SPDX-License-Identifier: GPL-2.0

/dts-v1/;
/plugin/;

#include "meridian-evt-v1.0.dtsi"

/ {
	model = "Google Meridian LTE EVT 1.0";
	qcom,board-id = <0x010022 0x1>;
	board_id = <0x020d03>;
	board_rev = <0x010000>;
};
