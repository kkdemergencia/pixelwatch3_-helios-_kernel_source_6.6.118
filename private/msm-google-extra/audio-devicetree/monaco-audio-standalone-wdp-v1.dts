/*
 * Copyright (c) 2024 Qualcomm Innovation Center, Inc. All rights reserved.
 * SPDX-License-Identifier: BSD-3-Clause
 */

/dts-v1/;
/plugin/;

#include "monaco-audio.dtsi"
#include "monaco-audio-overlay.dtsi"

/ {
	model = "Qualcomm Technologies, Inc. Monaco standalone WDP V1.0";
	qcom,board-id = <0x010024 0x1>;
};

