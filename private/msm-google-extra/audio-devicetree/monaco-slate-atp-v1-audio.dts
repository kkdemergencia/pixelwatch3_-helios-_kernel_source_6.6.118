/*
 * Copyright (c) 2024 Qualcomm Innovation Center, Inc. All rights reserved.
 * SPDX-License-Identifier: BSD-3-Clause
 */

/dts-v1/;
/plugin/;

#include "monaco-slate-audio.dtsi"

/ {
	model = "Qualcomm Technologies, Inc. Monaco ATP V1.0";
	qcom,board-id = <0x010021 0x0>;
};

