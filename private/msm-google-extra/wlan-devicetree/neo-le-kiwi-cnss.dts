/dts-v1/;
/plugin/;

#include "neo-le-kiwi-cnss.dtsi"

/ {
	model = "Qualcomm Technologies, Inc. NEO IDP HMT";
	compatible = "qcom,neo-idp", "qcom,neo", "qcom,idp", "qcom,neo-qxr";
	qcom,msm-id = <525 0x10000>;
	qcom,board-id = <34 1>, <0x10026 0x1>;
};
