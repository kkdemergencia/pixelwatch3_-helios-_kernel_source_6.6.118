## private/google-modules/rotary-encoders/pat9xxx/Kconfig
```kconfig
#
# PixArt PAT9xxx optical tracking sensor
#

config INPUT_PIXART_9XXX
	tristate "PixArt PAT9xxx optical tracking sensor driver"
	depends on INPUT && I2C && GPIOLIB
	help
	  Say Y to enable support for the PixArt PAT9xxx optical tracking
	  sensor driver.

	  If unsure, say N.

	  To compile this driver as a module, choose M here: the module will be
	  called pat9xxx.
```

## private/google-modules/rotary-encoders/petc_input_filter/Kconfig
```kconfig
#
# PETC input filter driver configuration
#

config INPUT_PETC_INPUT_FILTER
	tristate "PETC input filter driver"
	depends on INPUT
	help
	  Say Y to enable support for the PETC input filter.
	  If unsure, say N.

	  To compile this driver as a module, choose M here: the
	  module will be called petc-if.
```

## private/google-modules/soc/msm/Kconfig.ext_modules
```kconfig
# SPDX-License-Identifier: GPL-2.0

source "$(KCONFIG_EXT_MODULES_PREFIX)private/google-modules/nanohub/Kconfig"

source "$(KCONFIG_EXT_MODULES_PREFIX)private/google-modules/wac/autobahn/Kconfig"
```

## private/google-modules/soc/msm/drivers/soc/qcom/modemsmem/Kconfig
```kconfig
config MODEMSMEM
	bool "Modem SMEM driver"
	default N
	---help---
	Enable to pass device information and other data to shared memory for
	the modem subsystem
```

## private/google-modules/touch/common/Kconfig
```kconfig
config CONFIG_WEAR_TOUCH_INTERFACE
	tristate "Wear Touch Interface"
	help
	  Enable this module to provide a common touch interface driver.
```

## private/google-modules/touch/raydium/rm6d031/Kconfig
```kconfig
#
# Raydium RM6D031 touchscreen driver configuration
#
config TOUCHSCREEN_RM6D031
	tristate "Raydium RM6D031"
	default y
	help
	  Say Y here if you have a Raydium RM6D031 touchscreen connected
	  to your system.

	  If unsure, say N.

	  If you would like to compile this driver as a module, say M.
```

## private/google-modules/wac/autobahn/Kconfig
```kconfig
config AUTOBAHN
	tristate "Autobahn"
	select IIO
	help
	  Enable support for the autobahn sensorhub driver.

	  This driver supports the android autobahn sensorhub. The nanohub
	  interface kernel exports and nanohub character device interface are
	  exposed when this is enabled.

	  If in doubt, say N here. Set to M to compile this driver as a module.

if AUTOBAHN

config AUTOBAHN_DASSERT
	bool "Autobahn debug assert"
	default n
	help
	  Enable Autobahn debug assertions.

config AUTOBAHN_TESTS
	tristate "Autobahn tests"
	default n
	help
	  Set to Y to enable Autobahn Kunit tests.

config AUTOBAHN_FAULT_INJECTION
	bool "Autobahn fault injection framework"
	default y
	depends on FAULT_INJECTION
	depends on FAULT_INJECTION_DEBUG_FS
	help
	  Enable Autobahn driver fault injection capabilities.

	  All faults are disabled on boot and must be explicitly enabled.

	  Fault injection is configurable through the DebugFS interface,
	  in /sys/kernel/debug/fault_*.

choice
	prompt "Integrity Check Algorithm"
	default AUTOBAHN_INTEGRITY_CHECK_CRC16_CCITT
	help
	  This option allows to select the algorithm used to verify the
	  integrity of the data received from the sensor hub. The selected
	  algorithm will be used to compute a checksum on the received data
	  and compare it with the checksum received from the sensor hub.
	  If the checksums do not match, the data will be discarded.

config AUTOBAHN_INTEGRITY_CHECK_CRC16_CCITT
	bool "CRC16_CCITT"
	help
	  Select CRC16_CCITT as the integrity check algorithm.
	  This algorithm is a 16-bit cyclic redundancy check based on
	  the CCITT polynomial. The selected algorithm will be used
	  to compute a checksum on the received data and compare it
	  with the checksum received from the sensor hub. If the
	  checksums do not match, the data will be discarded.

config AUTOBAHN_INTEGRITY_CHECK_CRC32
	bool "CRC32"
	help
	  Select CRC32 as the integrity check algorithm.
	  This algorithm is a 32-bit cyclic redundancy check based on
	  the IEEE polynomial. The selected algorithm will be used
	  to compute a checksum on the received data and compare it
	  with the checksum received from the sensor hub. If the
	  checksums do not match, the data will be discarded.

endchoice

config AUTOBAHN_FRAME_SIZE_BYTES
	int "The frame size in bytes"
	default 264
	range 264 65544
	help
	  Total number of bytes in a frame. A frame consists of: header, payload
	  and foooter/trailer. Among other things, the header specifies the
	  frame type, payload size and, optionally, the channel number.
	  The payload usually contains the datagram(s), while the footer/trailer
	  contains an integrity check.

endif # AUTOBAHN
```

## private/google-modules/wac/autobahn/configs/frame_1032b_defconfig
```kconfig
CONFIG_AUTOBAHN=m
CONFIG_AUTOBAHN_FRAME_SIZE_BYTES=1032
CONFIG_AUTOBAHN_INTEGRITY_CHECK_CRC32=y
```

## private/private/google-modules/nanohub/Kconfig
```kconfig
config NANOHUB
	tristate "Nanohub"
	select IIO
	help
	  Enable support for the nanohub sensorhub driver.

	  This driver supports the android nanohub sensorhub.

	  If in doubt, say N here.

if NANOHUB

config NANOHUB_SPI
	bool "Nanohub SPI"
	default y
	help
	  Enable nanohub SPI support.

	  If in doubt, say Y here.

config NANOHUB_BL_NXP
	bool "Nanohub NXP bootloader support"
	help
	  Enable nanohub NXP bootloader support.

	  If in doubt, say N here.

config NANOHUB_BL_ST
	bool "Nanohub STMicro bootloader support"
	help
	  Enable nanohub STMicro bootloader support.

	  If in doubt, say N here.

config NANOHUB_SPI_AMBIQ_HD
	bool "Nanohub SPI with Ambiq half-duplex SPI"
	help
	  Enable support for Ambiq half-duplex SPI being connected to this device

config NANOHUB_SPI_AMBIQ_FD
	bool "Nanohub SPI with Ambiq full-duplex SPI"
	help
	  Enable support for Ambiq full-duplex SPI being connected to this device

endif # NANOHUB
```

## private/private/google-modules/touch/parade_touch/tma525c/defconfig
```kconfig
CONFIG_TOUCHSCREEN_PARADE=m
CONFIG_TOUCHSCREEN_PARADE_MT_B=y
CONFIG_TOUCHSCREEN_PARADE_DEVICETREE_SUPPORT=m
CONFIG_TOUCHSCREEN_PARADE_I2C=m
CONFIG_TOUCHSCREEN_PARADE_DEBUG_MDL=m
CONFIG_TOUCHSCREEN_PARADE_LOADER=m
CONFIG_TOUCHSCREEN_PARADE_DEVICE_ACCESS=m
```
